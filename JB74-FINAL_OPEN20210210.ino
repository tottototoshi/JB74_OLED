
#include <U8g2lib.h>
#include <U8x8lib.h>
#include <DHT.h>
#include <DHT_U.h>
#include <WiFi.h>
#include <time.h>
#define JST     3600* 9 //日本
U8G2_SH1122_256X64_1_4W_HW_SPI u8g2(U8G2_R2, /* cs=*/ 5, /* dc=*/ 12, /* reset=*/ 14);        // Enable U8G2_16BIT in u8g2.h

//起動画面98x48
const unsigned char bootimg[] PROGMEM = {
  0x00, 0x00, 0x00, 0x00, 0x00, 0x00, 0x00, 0x00, 0x00, 0x00, 0x00, 0x00, 
  0x00, 0x00, 0x00, 0x00, 0x00, 0x00, 0xFC, 0x01, 0x00, 0x00, 0x00, 0x00, 
  0x00, 0x00, 0x00, 0x00, 0x00, 0x00, 0x00, 0xFE, 0x03, 0x00, 0x00, 0x00, 
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  0x7F, 0xFC, 0xC1, 0xFF, 0xF7, 0x01, 0xDF, 0x07, 0xFC, 0x07, 0xF0, 0x03, 
  };
//℃の表示  
const unsigned char doC[] PROGMEM = {
  0x00, 0x00, 0x06, 0x00, 0xC9, 0x03, 0x69, 0x0C, 0x26, 0x10, 0x30, 0x00, 
  0x30, 0x00, 0x30, 0x00, 0x70, 0x10, 0x60, 0x08, 0xC0, 0x04, 0x80, 0x03, 
  0x00, 0x00,
  };
//シートベルト警告
const unsigned char belt[] PROGMEM = {
  0x00, 0x00, 0x20, 0x00, 0x00, 0x00, 0x00, 0x00, 0xFC, 0x01, 0x00, 0x00, 
  0x00, 0x00, 0xFE, 0x01, 0x00, 0x00, 0x00, 0x00, 0xFF, 0x01, 0x00, 0x00, 
  0x00, 0x00, 0xFF, 0x03, 0x00, 0x00, 0x00, 0x00, 0xFF, 0x03, 0x00, 0x00, 
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  0x00, 0x00, 0x82, 0x00, 0x00, 0x00,
  };

//---------------------------------------------------------------------
//const char* ssid = "**********";      //自宅    
//const char* password = "**********";   //自宅

const char* ssid = "**********";      //JB74    
const char* password = "**********";   //JB74


//---------------------------------------------------------------------
//時計の接頭0対応
int hourXpoint;  //時のX描画位置
int minXpoint;   //分のX描画位置
int secXpoint;   //秒のX描画位置  
int monthXpoint; //月のX描画位置
int dayXpoint;   //日のX描画位置  

//センサー設定-------------------------------------------
const int PIN_DHT = 4;
DHT dht( PIN_DHT, DHT11 );
unsigned long prev;      //周期処理
unsigned long interval;  //周期処理
String te="--";          //温度
String hu="--";          //湿度
float prete=0;           //温度の平均処理
float prehu=0;           //湿度の平均処理
float preteave=0;        //温度の平均処理
float prehuave=0;        //湿度の平均処理
//-----------------------------------------------------

int i=0;   //センサー平均処理用

//-------------------------------------------------------
//シートベルト警告用
const int buttonR = 32;  //スイッチ32
const int buttonL = 33;  //スイッチ33
int valR=0;
int valL=0;

//接続中表記用
int k=0;


void cleardisplay(){ //画面消去
  u8g2.firstPage();
    do {
  u8g2.setDrawColor(0);
  u8g2.drawBox(0, 0, 255, 63);
  u8g2.setDrawColor(1);
    } while ( u8g2.nextPage() );
}    



void setup() {
pinMode(buttonR,INPUT);
pinMode(buttonL,INPUT);
  
u8g2.begin();  

//起動画面の表示-------------------------------------------
    u8g2.firstPage();
    do {
        u8g2.drawXBMP( 55, 10, 98, 48, bootimg);
    } while ( u8g2.nextPage() );
delay(2000);
 
//------------------------------------------------------------  
  Serial.begin(115200);
  delay(100);
//---------------------------------------------------------  
//WiFi接続
  Serial.print("\n\nStart\n");
  WiFi.begin(ssid, password);
  while(WiFi.status() != WL_CONNECTED) {
    Serial.print('.');
    delay(500);
  }
  Serial.println();
  Serial.printf("Connected, IP address: ");
  Serial.println(WiFi.localIP());
//-----------------------------------------------------------
//時間同期
  configTime( JST, 0, "ntp.nict.jp", "ntp.jst.mfeed.ad.jp");
//-----------------------------------------------------------
//消去
cleardisplay();
delay(1000);

//---------------------------------
//WiFi接続完了の表示
    u8g2.firstPage();
    do {
    u8g2.setFont(u8g_font_timR12);
    u8g2.drawStr( 50, 30, "Connected!");
    u8g2.drawStr( 10, 50, "IP address:"); 
    u8g2.setCursor(90,50);
    u8g2.print(WiFi.localIP());
    } while ( u8g2.nextPage() );
  delay(3000);
//----------------------------------------------------------------------
//センサー開始
    dht.begin();    
//--------------------------------------------------------------------    
//センサー読み取り周期処理設定
  prev = 0;              // 前回実行時刻を初期化
  interval = 2000;       // 実行周期を設定
}

void loop() {

  
//---------------------------------------------------------------
//センサー読み取り周期処理開始
  unsigned long curr = millis();    // 現在時刻を取得
  if ((curr - prev) >= interval) {  // 前回実行時刻から実行周期以上経過していたら
    i=i+1;

  //センサー値取得
    bool isFahrenheit = true;
   float percentHumidity = dht.readHumidity();              //湿度取得
   float temperature = dht.readTemperature();               //温度取得
   if (isnan(percentHumidity) || isnan(temperature)) {      //エラー処理
    Serial.println("ERROR");
    return;
    }

  //10回平均を出す
  if(i<=10){                          //9回目までは
     prete=prete+temperature;         //累積していく
     prehu=prehu+percentHumidity;     //累積していく
      Serial.print(i);
      Serial.println(",");
  }else{                              //10回目なら
     preteave=prete/10;               //平均する
     prehuave=prehu/10;               //平均する
     te=String(preteave, 1);          //桁揃えした温度を代入
     hu=String(prehuave, 0);          //桁揃えした湿度を代入
     i=0;
     prete=0;
     prehu=0;
     Serial.print(" : ");
     Serial.println(te);
  }

    prev = curr;                    // 前回実行時刻を現在時刻で更新

  }
// 周期処理終了-----------------------------------------------------

  
//-------------------------------------------------------------
//時計処理  
  time_t t;                                                                     //time_t型
  struct tm *tm;                                                                //構造体定義
  static const char *wd[7] = {"Sun","Mon","Tue","Wed","Thr","Fri","Sat"};       //曜日
  t = time(NULL);   
  tm = localtime(&t);
  Serial.printf(" %04d/%02d/%02d(%s) %02d:%02d:%02d\n",
        tm->tm_year+1900, tm->tm_mon+1, tm->tm_mday,
        wd[tm->tm_wday],
        tm->tm_hour, tm->tm_min, tm->tm_sec);
  delay(1000);

//-------------------------------------------------------------------
//シートベルト警告処理
valR=digitalRead(buttonR);
valL=digitalRead(buttonL);

if (valR==LOW && valL==LOW){                          //両方警告
  u8g2.firstPage();
    do {
        u8g2.drawXBMP( 15, 10, 42, 51, belt); 
        u8g2.drawXBMP( 145, 10, 42, 51, belt); 
    } while ( u8g2.nextPage() );
    delay(800);
    cleardisplay();
 
}else if (valL==LOW){                                 //左警告
   u8g2.firstPage();
    do {
        u8g2.drawXBMP( 15, 10, 42, 51, belt); 
    } while ( u8g2.nextPage() );
    delay(800);
    cleardisplay();
}else if (valR==LOW){                                 //右警告
   u8g2.firstPage();
    do {
        u8g2.drawXBMP( 145, 10, 42, 51, belt); 
    } while ( u8g2.nextPage() );
    delay(800);
    cleardisplay();

}else{                                                //通常処理

//表示---------------------------------------------   
  u8g2.firstPage();
  do {
   
//温度湿度
    u8g2.setFont(u8g_font_timR12);
    u8g2.drawStr( 5, 15, "temp");
    u8g2.setCursor(50,15);
    u8g2.print(te);                        //桁揃え温度表記
    u8g2.drawXBMP( 82, 3, 13, 13, doC);    //℃表記
    u8g2.drawStr( 120, 15, "humid");
    u8g2.setCursor(170,15);
    u8g2.print(hu);                        //桁揃え湿度表記
    u8g2.drawStr( 190, 15, "%");
    
//時計
hourXpoint=55;    //時X座標
minXpoint=120;    //分X座標
secXpoint=175;    //秒X座標  
monthXpoint=5;    //月X座標
dayXpoint=22;     //日X座標

if(tm->tm_hour<10){                                  //時が10以下だったら
  hourXpoint=hourXpoint+25;                          //オフセットさせる
  }
if(tm->tm_min<10){                                   //分が10以下だったら
     u8g2.setFont(u8g2_font_logisoso38_tf);
     u8g2.drawStr(minXpoint,63,"0");                 //0を接頭させる
     minXpoint=minXpoint+25;                         //オフセットさせる
  }
if(tm->tm_sec<10){                                   //秒が10以下だったら
     u8g2.setFont(u8g_font_timR12);
     u8g2.drawStr(secXpoint,60,"0");                 //0を接頭させる
     secXpoint=secXpoint+8;                          //オフセットさせる
  }
if(tm->tm_mon+1<10){
     monthXpoint=monthXpoint+5;                      //オフセットさせる
  }
if(tm->tm_mday<10){
      dayXpoint=dayXpoint+5;                         //オフセットさせる
  }

    u8g2.setFont(u8g2_font_logisoso38_tf);
    u8g2.setCursor(hourXpoint,63);                                                    //時
    u8g2.print(tm->tm_hour);
    u8g2.drawStr( 105, 63, ":");
    u8g2.setCursor(minXpoint,63);                                                     //分
    u8g2.print(tm->tm_min);
    u8g2.setFont(u8g_font_timR12);
    u8g2.setCursor(monthXpoint,42);                                                   //月/日
    u8g2.print(tm->tm_mon+1);  u8g2.print(" / ");   u8g2.print(tm->tm_mday);
    u8g2.setCursor(7,58);                                                             //曜日
    u8g2.print("(");    u8g2.print(wd[tm->tm_wday]);    u8g2.print(")");   
    u8g2.setCursor(secXpoint,60);                                                     //秒
    u8g2.print(tm->tm_sec);
    u8g2.drawLine(0,18,205,18);                                                       //横線

  } while ( u8g2.nextPage() );
  
  }
}
